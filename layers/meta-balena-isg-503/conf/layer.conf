## layers/meta-balena-isg-503/conf/layer.conf
```bitbake
BBPATH .= ":${LAYERDIR}"

BBFILES += "${LAYERDIR}/recipes-*/*/*.bb \
            ${LAYERDIR}/recipes-*/*/*.bbappend"

BBFILE_COLLECTIONS += "balena-isg-503"
BBFILE_PATTERN_balena-isg-503 := "^${LAYERDIR}/"
BBFILE_PRIORITY_balena-isg-503 = "1337"

LAYERSERIES_COMPAT_balena-isg-503= "kirkstone"

# balena-image-initramfs-1.0-r0 do_image_cpio: The rootfs size 36864(K) exceeds IMAGE_ROOTFS_MAXSIZE
# ref balena-raspberrypi :
# As per https://github.com/balena-os/meta-balena/pull/2411
# we only do this for the Pi3-64 Pi4-64, which don't have
# enough rootfs space for the Honister update.
FULL_OPTIMIZATION:isg-503 = "-Os -pipe ${DEBUG_FLAGS}"
# we do not use Rockchip's u-boot
BBMASK += "meta-rockchip/recipes-bsp/u-boot"
# we do not use Rockchip's kernel
BBMASK += "meta-isg/recipes-kernel/linux"
```

## layers/meta-balena-isg-503/conf/machine/isg-503.conf
```bitbake
#@TYPE: Machine
#@NAME: PINE64 ROCKPro64

SOC_FAMILY = "px30"

RK_ISP_VERSION := "1"

require conf/machine/include/soc-family.inc
require conf/machine/include/arm/arch-armv8a.inc

PREFERRED_PROVIDER_virtual/bootloader = "u-boot-rockchip"

PREFERRED_PROVIDER_virtual/kernel = "linux-rockchip"

SERIAL_CONSOLES = "1500000;ttyFIQ0"
KERNEL_IMAGETYPE = "Image"
KBUILD_DEFCONFIG = "px30_linux_defconfig"
KERNEL_DEVICETREE = "rockchip/px30-evb-ddr3-v10-linux.dtb"

UBOOT_MACHINE = "evb-px30_defconfig"

#RK_WIFIBT_FIRMWARES = " \
#	rkwifibt-firmware-ap6354-wifi \
#	rkwifibt-firmware-ap6354-bt \
#	brcm-tools \
#"

MACHINE_EXTRA_RRECOMMENDS:append = " \
	linux-firmware-rk-cdndp \
"

FIRMWARE_COMPRESSION = "1"
```
